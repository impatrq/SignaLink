## MQTT/Prototipo V 1.0/Mano Derecha/mqtt5/main/Kconfig.projbuild
```kconfig
menu "Example Configuration"

    config BROKER_URL
    string "MQTT Broker URL"
    default "mqtt://192.168.4.1:1884"
    help
      Dirección URI por defecto del broker MQTT.

    config EXAMPLE_MQTT_USERNAME
    string "MQTT username"
    default "franco"

    config EXAMPLE_MQTT_PASSWORD
    string "MQTT password"
    default "_fr4nco_"

endmenu
```

## Prototipo V 2.0/Mano Izquierda 2.0/mqtt5/main/Kconfig.projbuild
```kconfig
menu "Example Configuration"

    config BROKER_URL
        string "Broker URL"
        default "mqtt://mqtt.eclipseprojects.io"
        help
            URL of the broker to connect to

    config BROKER_URL_FROM_STDIN
        bool
        default y if BROKER_URL = "FROM_STDIN"

    config EXAMPLE_PIN_NUM_SDA
        int "I2C SDA pin"
        default 6

    config EXAMPLE_PIN_NUM_SCL
        int "I2C SCL pin"
        default 7

    config EXAMPLE_PIN_NUM_RST
        int "LCD reset pin (use -1 to disable)"
        default -1

    config EXAMPLE_I2C_HW_ADDR
        hex "I2C hardware address for OLED (7-bit)"
        default 0x3C

    choice EXAMPLE_LCD_CONTROLLER
        prompt "LCD controller model"
        default EXAMPLE_LCD_CONTROLLER_SSD1306
        help
            Select LCD controller model

        config EXAMPLE_LCD_CONTROLLER_SSD1306
            bool "SSD1306"

        config EXAMPLE_LCD_CONTROLLER_SH1107
            bool "SH1107"
    endchoice

    if EXAMPLE_LCD_CONTROLLER_SSD1306
        choice EXAMPLE_SSD1306_HEIGHT
            prompt "SSD1306 Height in pixels"
            default EXAMPLE_SSD1306_HEIGHT_64
            help
                Height of the display in pixels. a.k.a vertical resolution

            config EXAMPLE_SSD1306_HEIGHT_64
                bool "64"
            config EXAMPLE_SSD1306_HEIGHT_32
                bool "32"
        endchoice

        config EXAMPLE_SSD1306_HEIGHT
            int
            default 64 if EXAMPLE_SSD1306_HEIGHT_64
            default 32 if EXAMPLE_SSD1306_HEIGHT_32
    endif

endmenu
```
